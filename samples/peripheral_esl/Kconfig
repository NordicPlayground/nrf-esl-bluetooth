## samples/peripheral_esl/Kconfig
```kconfig
#
# Copyright (c) 2022 Nordic Semiconductor
#
# SPDX-License-Identifier: LicenseRef-Nordic-5-Clause
#

source "Kconfig.zephyr"

menu "Nordic ESL BLE GATT and PAwR servicee"

config BT_ESL_THREAD_STACK_SIZE
	int "Thread stack size"
	default 1024
	help
	  Stack size used in each of the two threads

config BT_ESL_SECURITY_ENABLED
	bool "Enable security"
	select BT_SMP
	select BT_BONDABLE
	select BT_BONDING_REQUIRED
	help
	  "Enable BLE security for the ESL service"

config ESL_SIMULATE_DISPLAY
	bool "Use LED2 on DK board to simulate display"
	help
	  "LED2 on DK will blink few times when receive display image ECP command"

config ESL_SIMULATE_DISPLAY_BLINK_TIMES
	int "LED blinking times to indicate display image change"
	default 5
	help
	  "How many times to blink"

config BT_ESL_PTS
	bool "ESL peripheral for PTS test"
	help
	  Enable PTS test for ESL peripheral

config ESL_POWER_PROFILE
	bool "Minimize power cunsumption for measure current"
	help
	  Turn off SPI and EPD power when not in use

config ESL_NFC_SUPPORT
	bool "ESL support NFC"
	imply NFC_T2T_NRFXLIB
	imply NFC_NDEF
	imply NFC_NDEF_MSG
	imply NFC_NDEF_RECORD
	imply NFC_NDEF_TEXT_RECORD
	help
	  Enable NFC support for ESL peripheral. Use the NFC tag to expose a greeting message record to NFC polling devices.
	  The message could be MAC address or everthing. Or use NFC to wake up ESL from shipping mode.

config ESL_SHIPPING_MODE
	bool "ESL shipping mode"
	select POWEROFF
	help
	  Make ESL enter system_off immediately. Wake ESL by NFC or button.
if ESL_SHIPPING_MODE
choice ESL_SHIPPING_WAKE_BY
	prompt "ESL shipping mode wake by"
	default ESL_SHIPPING_WAKE_BY_BOTH
	help
	  Select the way to wake up ESL from shipping mode
	config ESL_SHIPPING_WAKE_BY_NFC
	bool "NFC could wake ESL"

	config ESL_SHIPPING_WAKE_BY_BUTTON
		depends on ESL_NFC_SUPPORT
		bool "Button could wake ESL"

	config ESL_SHIPPING_WAKE_BY_BOTH
	bool "NFC + Button"
endchoice # ESL_SHIPPING_WAKE_BY

if ESL_SHIPPING_WAKE_BY_BUTTON || ESL_SHIPPING_WAKE_BY_BOTH
config ESL_WAKE_GPIO
	int "GPIO Pin number of wake up button. Use absolute pin number without port number."
	default 12
	help
	  Port 0 as 0, Port1 as 32. Default is P0.12 as button2 on DK board.

endif # WAKE_BY_BUTTON || WAKE_BY_BOTH
endif # SHIPPING_MODE

module = PERIPHERAL_ESL
module-str = peripheral esl
source "${ZEPHYR_BASE}/subsys/logging/Kconfig.template.log_config"
endmenu

rsource "../../service/Kconfig.esl"
```

## samples/peripheral_esl/conf/nrf52833dk_nrf52833/child_image/mcuboot/boards/nrf52833dk_nrf52833.conf
```kconfig
#
# Copyright (c) 2023 Nordic Semiconductor ASA
#
# SPDX-License-Identifier: LicenseRef-Nordic-5-Clause
#

CONFIG_BOOT_MAX_IMG_SECTORS=256
# CONFIG_PM_PARTITION_SIZE_MCUBOOT=0x10000
CONFIG_PM_PARTITION_SIZE_MCUBOOT=0xc000
CONFIG_SIZE_OPTIMIZATIONS=y
CONFIG_MAIN_STACK_SIZE=20480
# External Flash
CONFIG_FLASH=y
CONFIG_SPI=y
CONFIG_SPI_NOR=y
CONFIG_SPI_NOR_SFDP_DEVICETREE=y
CONFIG_MULTITHREADING=y
CONFIG_PM_OVERRIDE_EXTERNAL_DRIVER_CHECK=y

# Change default flash erase size for flexible flash layout
CONFIG_SPI_NOR_FLASH_LAYOUT_PAGE_SIZE=4096
CONFIG_BOOT_ERASE_PROGRESSIVELY=y
CONFIG_PM_EXTERNAL_FLASH_MCUBOOT_SECONDARY=y
CONFIG_FPROTECT=y

# Enable serial debug for MCUBOOT
# CONFIG_CBPRINTF_NANO=y
# CONFIG_CONSOLE=y
# CONFIG_LOG=y
# CONFIG_UART_NRFX=y
```

## samples/peripheral_esl/driver/EPD/Kconfig
```kconfig
config EPD_4IN2_V1
	bool "Waveshare 4.2 inch e-paper display V1"

config EPD_4IN2_V2
	bool "Waveshare 4.2 inch e-paper display V2"

config EPD_1IN54B_V2
	bool "Waveshare 1.54 inch 3 color e-paper display V2"

config EPD_2IN9B_V3
	bool "Waveshare 2.9 inch 3 color e-paper display V3"

config EPD_2IN13B_V3
	bool "Waveshare 2.13 inch 3 color e-paper display V3"

module = EPD_DRIVER
module-str = EPD_DRIVER
source "${ZEPHYR_BASE}/subsys/logging/Kconfig.template.log_config"
```

## samples/peripheral_esl/dts/bindings/drivers/generic,epd.yaml
```yaml
description: |
    E-Paper display controller

    The origin is in the upper left corner when the FPC line is facing down.
    Source = width = x, Gate = height = y.

include: [spi-device.yaml]

compatible: "generic,epd"

properties:
    vcc-gpios:
      type: phandle-array
      description: |
        VCC pin.

        The VCC pin of E-Paper is active low.

    busy-gpios:
      type: phandle-array
      required: true
      description: |
        BUSY pin.

        The BUSY pin of E-Paper is active high.

    reset-gpios:
      type: phandle-array
      required: true
      description: |
        RESET pin.

        The RESET pin of E-Paper is active low.

    dc-gpios:
      type: phandle-array
      required: true
      description: |
        DC pin.

        The DC pin of E-Paper is active low (transmission command byte).

on-bus: spi
```

## simple_epd_demo/paint/Kconfig
```kconfig
config PAINT_COLORS
    int "Number of colors"
    default 3 if ESL_DISPLAY_TYPE = 6
    default 2
    help
      Number of colors to use in the paint application.

config PAINT_WB_ON
    int "white black frame bit value indicating to which color"
    range 0 1
    default 0
    help
      0 means bit on white color, bit off black color
      1 means bit on black color, bit off white color

config PAINT_RW_ON
    int "red white frame bit value indicating to which color"
    range 0 1
    default 0
    help
      0 means bit on white color, bit off red color
      1 means bit on red color, bit off white color

config PAINT_MSB_FIRST
    bool "MSB first"
    default y
    help
      If set, the paint application will draw the most significant bit first.
      Otherwise, the least significant bit will be drawn first.

module = JF_PAINT
module-str = JF_PAINT
source "${ZEPHYR_BASE}/subsys/logging/Kconfig.template.log_config"
```
