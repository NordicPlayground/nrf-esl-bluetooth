/ {
	chosen {
		zephyr,display = &ssd16xx;
	};
};

&arduino_spi {
	status = "okay";
	cs-gpios = <&arduino_header 16 GPIO_ACTIVE_LOW>;	/* D10 */
	ssd16xx: ssd16xxfb@0 {
		compatible = "waveshare,HINK-E0213-G01",
		             "solomon,ssd1680",
		             "solomon,ssd16xxfb";
		status = "okay";
		spi-max-frequency = <8000000>;
		reg = <0>;
		width = <250>;
		height = <122>;
		dc-gpios = <&arduino_header 15 GPIO_ACTIVE_LOW>;        /* D9 */
		reset-gpios = <&arduino_header 14 GPIO_ACTIVE_LOW>;                /* D8 */
		busy-gpios = <&arduino_header 13 GPIO_ACTIVE_HIGH>;        /* D7 */
	};
};
